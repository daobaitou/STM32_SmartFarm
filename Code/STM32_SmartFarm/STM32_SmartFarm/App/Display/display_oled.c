/**
 * @file    display_oled.c
 * @author  王国维
 * @date    2026-04-20
 * @brief   0.96寸OLED显示驱动 (SSD1306, I2C, 128x64)
 */

#include "display_oled.h"
#include "soft_i2c.h"
#include <string.h>

#define OLED_ADDR    0x3C
#define OLED_WIDTH   128
#define OLED_HEIGHT  64

static uint8_t oled_buf[OLED_HEIGHT / 8][OLED_WIDTH];

/* 6x8 ASCII字体 (0x20~0x7E, 共95个字符) */
static const uint8_t font6x8[][6] = {
    {0x00,0x00,0x00,0x00,0x00,0x00}, /* space */
    {0x00,0x00,0x5F,0x00,0x00,0x00}, /* ! */
    {0x00,0x07,0x00,0x07,0x00,0x00}, /* " */
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    {0x08,0x08,0x2A,0x1C,0x08,0x00}, /* ~ */
};

static void oled_write_cmd(uint8_t cmd)
{
    uint8_t buf[2] = {0x00, cmd};
    Soft_I2C_Write(OLED_ADDR, buf, 2);
}

static void oled_write_data_batch(uint8_t *data, uint16_t len)
{
    Soft_I2C_Write(OLED_ADDR, data, len);
}

HAL_StatusTypeDef OLED_Init(void)
{
    Soft_I2C_Init();
    HAL_Delay(200);

    oled_write_cmd(0xAE); /* 关显示 */
    oled_write_cmd(0xD5); oled_write_cmd(0x80); /* 时钟分频 */
    oled_write_cmd(0xA8); oled_write_cmd(0x3F); /* 多路复用率 */
    oled_write_cmd(0xD3); oled_write_cmd(0x00); /* 显示偏移 */
    oled_write_cmd(0x40); /* 起始行 */
    oled_write_cmd(0x8D); oled_write_cmd(0x14); /* 电荷泵 */
    oled_write_cmd(0x20); oled_write_cmd(0x00); /* 页地址模式 */
    oled_write_cmd(0xA1); /* 段重映射 */
    oled_write_cmd(0xC8); /* COM扫描方向 */
    oled_write_cmd(0xDA); oled_write_cmd(0x12); /* COM引脚配置 */
    oled_write_cmd(0x81); oled_write_cmd(0xCF); /* 对比度 */
    oled_write_cmd(0xD9); oled_write_cmd(0xF1); /* 预充电 */
    oled_write_cmd(0xDB); oled_write_cmd(0x40); /* VCOMH */
    oled_write_cmd(0xA4); /* 全显示 */
    oled_write_cmd(0xA6); /* 正常显示 */
    oled_write_cmd(0xAF); /* 开显示 */

    OLED_Clear();
    OLED_Refresh();

    return HAL_OK;
}

void OLED_Clear(void)
{
    memset(oled_buf, 0, sizeof(oled_buf));
}

void OLED_Refresh(void)
{
    static uint8_t page_buf[1 + OLED_WIDTH];

    for (uint8_t page = 0; page < 8; page++)
    {
        oled_write_cmd(0xB0 + page);
        oled_write_cmd(0x00);
        oled_write_cmd(0x10);

        page_buf[0] = 0x40;
        memcpy(&page_buf[1], oled_buf[page], OLED_WIDTH);
        oled_write_data_batch(page_buf, 1 + OLED_WIDTH);
    }
}

void OLED_DrawPixel(uint8_t x, uint8_t y, uint8_t color)
{
    if (x >= OLED_WIDTH || y >= OLED_HEIGHT) return;
    uint8_t page = y / 8;
    uint8_t bit = y % 8;
    if (color)
        oled_buf[page][x] |= (1 << bit);
    else
        oled_buf[page][x] &= ~(1 << bit);
}

void OLED_DrawChar(uint8_t x, uint8_t y, char ch, uint8_t size)
{
    if (ch < 0x20 || ch > 0x7E) ch = 0x20;
    uint8_t idx = ch - 0x20;

    if (size == FONT_SMALL)
    {
        for (uint8_t i = 0; i < 6; i++)
        {
            for (uint8_t j = 0; j < 8; j++)
            {
                if (font6x8[idx][i] & (1 << j))
                    OLED_DrawPixel(x + i, y + j, 1);
                else
                    OLED_DrawPixel(x + i, y + j, 0);
            }
        }
    }
}

void OLED_DrawString(uint8_t x, uint8_t y, const char *str, uint8_t size)
{
    uint8_t w = (size == FONT_SMALL) ? 6 : 6;
    while (*str)
    {
        OLED_DrawChar(x, y, *str, size);
        x += w;
        str++;
    }
}

void OLED_Fill(uint8_t data)
{
    memset(oled_buf, data, sizeof(oled_buf));
    OLED_Refresh();
}
